## config/west.yml
```yaml
manifest:
  remotes:
    - name: zmkfirmware
      url-base: https://github.com/zmkfirmware
    - name: petejohanson
      url-base: https://github.com/petejohanson
  projects:
    - name: zmk
      remote: petejohanson
      revision: display/bongo-cat-widget
      revision: power/domains-and-device-runtime
      import: app/west.yml
  self:
    path: config
```
